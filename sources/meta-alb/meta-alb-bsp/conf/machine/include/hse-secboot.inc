## sources/meta-alb/meta-alb-bsp/conf/machine/include/hse-verifiedboot.inc
```bitbake
# Copyright 2023-2024 NXP

SDCARDIMAGE_BOOT_EXTRA_FILES:append = " linux-s32:kernel.itb"
```

## sources/meta-alb/meta-alb-bsp/conf/machine/include/s32-sim-base.inc
```bitbake
IMAGE_FSTYPES += "cpio.gz"
IMAGE_FSTYPES:remove = "flashimage"

DISTRO_FEATURES:append = " virtio"
DISTRO_FEATURES:remove = "systemd"
INIT_MANAGER = "mdev-busybox"
```

## sources/meta-alb/meta-alb-bsp/conf/machine/include/s32cc-base.inc
```bitbake
# Provides common settings for S32CC boards, emulation and simulation models
require conf/machine/include/s32-base.inc
require conf/machine/include/arm/armv8a/tune-cortexa53.inc

SOC_FAMILY:append = ":s32cc"

DEFAULTTUNE:s32cc ?= "cortexa53-crypto"
```

## sources/meta-alb/meta-alb-bsp/conf/machine/include/s32cc-sim-base.inc
```bitbake
require conf/machine/include/s32-sim-base.inc
require conf/machine/include/s32cc-base.inc

KERNEL_DEFCONFIG ?= "s32cc_defconfig"
```

## sources/meta-alb/meta-alb-bsp/conf/machine/include/s32g-pfems.inc
```bitbake
# Copyright 2023-2024 NXP

PFE_DT := "${KERNEL_DEVICETREE}"
PFEMS_DT := "${@d.getVar('KERNEL_DEVICETREE', True).replace('.${FLASHIMAGE_DTB_SUFFIX}', '-pfems.${FLASHIMAGE_DTB_SUFFIX}')}"
KERNEL_DEVICETREE ?= "${@bb.utils.contains('DISTRO_FEATURES', 'pfe-slave', '${PFEMS_DT}', '${PFE_DT}', d)}"
FLASHIMAGE_DTB_FILE = "${@d.getVar('KERNEL_DEVICETREE').replace('freescale/', '')}"
```

## sources/meta-alb/meta-alb-bsp/conf/machine/include/s32g.inc
```bitbake
require conf/machine/include/s32cc-board.inc
require ${@bb.utils.contains('DISTRO_FEATURES', 'pfe', 'conf/machine/include/s32g-pfe.inc', '', d)}

MACHINEOVERRIDES =. "s32g:"
```

## sources/meta-alb/meta-alb-bsp/conf/machine/s32g274a_emu.conf
```bitbake
#@TYPE: Machine
#@NAME: NXP S32G274A ZeBu EMULATOR
#@SOC: s32g274a
#@DESCRIPTION: Machine configuration for running the S32G274A ZeBu EMULATOR in 64-bit mode
#@MAINTAINER: Catalin Dan Udma <catalin-dan.udma@nxp.com>
# Copyright 2017-2019 NXP

require conf/machine/include/s32cc.inc

IMAGE_FSTYPES += "cpio.gz"

DISTRO_FEATURES:append += " virtio "
DISTRO_FEATURES:remove = " systemd"

UBOOT_CONFIG = "sdcard"

KERNEL_DEVICETREE ?= "freescale/s32g274a-emu.dtb"
KERNEL_DEFCONFIG ?= "s32cc_emu_defconfig"

UBOOT_DEFCONFIG = "s32g274a_emu_defconfig"
UBOOT_CONFIG[sdcard] = "${UBOOT_DEFCONFIG},,u-boot-nodtb.${UBOOT_SUFFIX}"

ITB_ROOTFS_TYPE = "cpio"

UBOOT_BOOTSPACE_OFFSET = "0"
UBOOT_BOOTSPACE_SEEK = "0"
```

## sources/meta-alb/meta-alb-bsp/recipes-bsp/arm-trusted-firmware/arm-trusted-firmware/s32.its
```
/* Copyright 2023,2024 NXP */

/dts-v1/;
/ {
    description = "kernel+dtb/fdt fit image";
    #address-cells = <1>;
    images {
            kernel-1 {
                description = "kernel image";
                data = /incbin/("<kernel_image>");
                type = "kernel";
                arch = "arm64";
                os = "linux";
                compression = "none";
                load = <0x82000000>;
                entry = <0x82000000>;
                kernel-version = <1>;
                hash-1 {
                    algo = "sha1";
                };
            };
            fdt-1 {
                description = "dtb blob";
                data = /incbin/("<dtb_blob>");
                type = "flat_dt";
                arch = "arm64";
                compression = "none";
                load = <0x84000000>;
                fdt-version = <1>;
                hash-1 {
                    algo = "sha1";
                };
            };
    };
    configurations {
        default = "conf-1";
            conf-1 {
                kernel = "kernel-1";
                fdt = "fdt-1";
                signature-1 {
                    algo = "sha1,rsa2048";
                    key-name-hint = "boot_key";
                    sign-images = "kernel", "fdt";
                };
            };
    };
};
```

## sources/meta-alpha/conf/distro/include/alpha-s32.inc
```bitbake
require conf/distro/fsl-auto.conf

DISTRO_NAME = "alpha-s32"
DISTRO_VERSION = "${ALPHA_RELEASE} (based on Auto Linux BSP ${ALB_RELEASE})"

# Features specific to the GoldVIP distros
DISTRO_FEATURES:append = " pfe-slave"
DISTRO_FEATURES:append = " llce llce-can-logger llce-can-multihost llce-linflex llce-lpspi"
DISTRO_FEATURES:append = " hse"

SJA1110_UC_FW ?= "${NXP_FIRMWARE_LOCAL_DIR}/sja1110_uc.bin"
SJA1110_SWITCH_FW ?= "${NXP_FIRMWARE_LOCAL_DIR}/sja1110_switch.bin"
ENABLE_DYNAMIC_BOOT_CONFIG ?= "true"

DISTRO_FEATURES:remove = " systemd"
DISTRO_FEATURES_BACKFILL_CONSIDERED:remove = " sysvinit"
VIRTUAL-RUNTIME_init_manager = "sysvinit"
VIRTUAL-RUNTIME_initscripts = "initscripts"
```

## sources/meta-alpha/conf/layer.conf
```bitbake
# We have a conf and classes directory, add to BBPATH.
BBPATH .= ":${LAYERDIR}"

BBFILE_COLLECTIONS:append = " alpha"
BBFILE_PATTERN_alpha = "^${LAYERDIR}/"
BBFILE_PRIORITY_alpha = "10"

# The dynamic-layers directory hosts the extensions and layer specific
# modifications related to NXP products.
#
# The .bbappend and .bb files are included if the respective layer
# collection is available.
BBFILES += "${@' '.join('${LAYERDIR}/dynamic-layers/%s/recipes*/*/*.bbappend' % layer \
                for layer in BBFILE_COLLECTIONS.split())}"
BBFILES += "${@' '.join('${LAYERDIR}/dynamic-layers/%s/recipes*/*/*.bb' % layer \
                for layer in BBFILE_COLLECTIONS.split())}"

# We have recipes-* directories, add to BBFILES.
BBFILES += " \
    ${LAYERDIR}/recipes-*/*/*.bb \
    ${LAYERDIR}/recipes-*/*/*.bbappend \
"

LAYERSERIES_COMPAT_alpha = "kirkstone scarthgap"

ALB_RELEASE = "${@d.getVar('RELEASE_BASE').replace('release/','').replace('bsp','').replace('_','')}"
ALPHA_RELEASE = "1.0"
```

## sources/meta-alpha/conf/machine/s32g399aalpha.conf
```bitbake
require conf/machine/include/s32g3.inc

MACHINE="s32g399aalpha"

ATF_PLAT = "s32g399aalpha"

UBOOT_DEFCONFIG = "s32g399aalpha_defconfig"
UBOOT_FLASH_DEFCONFIG = "s32g399aalpha_qspi_defconfig"

KERNEL_DEVICETREE ??= "freescale/s32g399a-alpha.dtb"

require conf/machine/include/s32g-pfems.inc
```
